VERSION ""

NS_ :

BS_:
BU_: Audio_Control_Module Audio_Interface_Module Bluetooth_Phone_Module Body_Electric_Module Front_Display_Interface_Module HVAC_Integrated_Module Instrustment_Cluster Parking_Aid_Module Powertrain_Control_Module Restraints_Control_Module Transmission_Control_Module On_Board_Diagnostics
BO_ 754 SWC: 8 Front_Display_Interface_Module
   SG_ AudioVolumeLevel : 0|16@1+ (2,0) [0|15] "Vol" Audio_Control_Module
   SG_ SWCPhoneBtn : 56|8@0+ (1,0) [0|0] "" Bluetooth_Phone_Module
   SG_ SWCVolUpBtn : 56|8@1+ (1,0) [0|0] "" Audio_Control_Module
   SG_ SWCVolDownBtn : 56|8@1+ (1,0) [0|0] "" Audio_Control_Module
   SG_ SWCModeBtn : 48|16@1+ (1,0) [0|0] "" Audio_Control_Module
   SG_ AudioCurrentMediaMode : 48|8@1+ (1,0) [0|0] "" Audio_Control_Module
   SG_ SWCSeekBtn : 56|8@1+ (1,0) [0|0] "" Audio_Control_Module

BO_ 764 MSG1: 8 Front_Display_Interface_Module

BO_ 718 ASCII_DATA: 8 Bluetooth_Phone_Module
   SG_ BPM_Pair : 0|16@4- (1,0) [0|0] "" Bluetooth_Phone_Module

BO_ 851 HVAC: 8 HVAC_Integrated_Module
   SG_ FanSpeed M : 56|63@1- (10,0) [0|0] "FanSpeed" HVAC_Integrated_Module
   SG_ VentStatus : 0|1@1+ (10,0) [0|0] "VentStatus" HVAC_Integrated_Module
   SG_ CabinTemp : 0|1@1+ (10,0) [0|0] "CabinTemp" HVAC_Integrated_Module
   SG_ ExternalTemp : 0|1@1+ (1,0) [0|0] "External Temp - Sense in LH mirror" HVAC_Integrated_Module

BO_ 296 MSG1: 8 Instrustment_Cluster
   SG_ HighBeamStatus : 29|8@1+ (1,0) [0|0] "" Instrustment_Cluster
   SG_ FogLampStatus : 0|8@1+ (1,0) [0|0] "" Instrustment_Cluster
   SG_ HeadLightsOn : 0|8@1+ (1,0) [0|1] "" Instrustment_Cluster
   SG_ HeadLightsAutoOn : 2|1@1+ (1,0) [2|2] "" Instrustment_Cluster
   SG_ IndicatorRight : 0|8@1+ (1,0) [0|0] "" Instrustment_Cluster
   SG_ IndicatorLeft : 0|8@1+ (1,0) [0|0] "" Instrustment_Cluster
   SG_ IllumLevelDisplay : 0|1@1+ (1,0) [0|0] "" Vector__XXX
   SG_ TurnStalkSwitchStatus : 0|1@1+ (1,0) [0|0] "" Vector__XXX

BO_ 724 MSG1: 8 Audio_Control_Module

BO_ 738 MSG2: 8 Audio_Control_Module

BO_ 751 MSG4: 8 Audio_Control_Module

BO_ 756 RDS_MESSAGE: 8 Audio_Control_Module

BO_ 757 RDS__MESSAGE: 8 Audio_Control_Module

BO_ 761 MSG7_MP3_Track_Folder: 8 Audio_Control_Module
   SG_ MP3_Folder : 0|1@1+ (1,0) [0|0] "" Front_Display_Interface_Module
   SG_ MP3_Track : 0|1@1+ (1,0) [0|0] "" Front_Display_Interface_Module

BO_ 512 MSG1: 8 Powertrain_Control_Module

BO_ 519 MSG2: 8 Powertrain_Control_Module

BO_ 528 MSG3: 8 Powertrain_Control_Module

BO_ 560 MSG4: 8 Powertrain_Control_Module

BO_ 832 MSG5: 8 Powertrain_Control_Module

BO_ 787 INTACTTEMP: 8 HVAC_Integrated_Module
   SG_ INTACTTEMP : 0|63@1- (100,2) [-255|255] "Degrees_C" HVAC_Integrated_Module

BO_ 737 MSG1: 8 Audio_Control_Module

BO_ 739 MSG2: 8 Audio_Control_Module

BO_ 748 MSG3: 8 Audio_Control_Module

BO_ 775 MSG4: 8 Body_Electric_Module
   SG_ SIGNAL19212 : 0|1@1+ (1,0) [0|0] "" Body_Electric_Module
   SG_ SIGNAL31203 : 0|1@1+ (1,0) [0|0] "" Body_Electric_Module
   SG_ SIGNAL1921220 : 0|1@1+ (1,0) [0|0] "" Body_Electric_Module
   SG_ SIGNAL1921297 : 0|1@1+ (1,0) [0|0] "" Body_Electric_Module
   SG_ SIGNAL1921250 : 0|1@1+ (1,0) [0|0] "" Body_Electric_Module

BO_ 777 MSG5: 8 Body_Electric_Module

BO_ 779 MSG6: 8 Body_Electric_Module

BO_ 781 MSG7: 8 Body_Electric_Module

BO_ 783 MSG8: 8 Body_Electric_Module

BO_ 785 MSG9: 8 Body_Electric_Module

BO_ 789 MSG10: 8 Body_Electric_Module

BO_ 791 MSG11: 8 Body_Electric_Module

BO_ 816 MSG12: 8 Body_Electric_Module

BO_ 1030 MSG13: 8 Body_Electric_Module

BO_ 1033 MSG14: 8 Body_Electric_Module

BO_ 1281 MSG15: 8 Body_Electric_Module

BO_ 1292 MSG16: 8 Body_Electric_Module

BO_ 1297 MSG17: 8 Body_Electric_Module

BO_ 1345 MSG18: 8 Body_Electric_Module

BO_ 1365 MSG19: 8 Body_Electric_Module

BO_ 1372 MSG20: 8 Body_Electric_Module

BO_ 1600 MSG21: 8 Body_Electric_Module

BO_ 1782 MSG22: 8 Body_Electric_Module

BO_ 1788 MSG23: 8 Body_Electric_Module

BO_ 301 MSG1: 8 Powertrain_Control_Module

BO_ 288 MSG1: 8 Powertrain_Control_Module

BO_ 1001 MSG2: 8 Powertrain_Control_Module

BO_ 1031 MSG3: 8 Powertrain_Control_Module

BO_ 1061 MSG4: 8 Powertrain_Control_Module
   SG_ Cruise : 0|1@1+ (1,0) [0|0] "" Powertrain_Control_Module
   SG_ CruiseTargetSetSpeed : 0|1@1+ (1,0) [0|0] "" Powertrain_Control_Module
   SG_ InstantEconomy : 0|1@1+ (1,0) [0|0] "" Powertrain_Control_Module
   SG_ InstantEconomyMode : 0|1@1+ (1,0) [0|0] "" Powertrain_Control_Module
   SG_ TurboBoostPressure : 0|1@1+ (1,0) [0|0] "" Powertrain_Control_Module

BO_ 1063 MSG5: 8 Powertrain_Control_Module
   SG_ EngineCoolantTemperature : 62|1@0+ (1,0) [0|150] "Degrees_C" Powertrain_Control_Module
   SG_ EngineOverheat : 0|1@1+ (1,0) [0|0] "" Powertrain_Control_Module
   SG_ EngineOilPressure : 15|1@1+ (1,0) [0|0] "" Powertrain_Control_Module
   SG_ OilPressureWarning : 0|1@1+ (1,0) [0|0] "" Powertrain_Control_Module
   SG_ ETC_Warning : 0|1@1+ (1,0) [0|0] "" Powertrain_Control_Module
   SG_ FuelPulse : 0|1@1+ (1,0) [0|0] "" Powertrain_Control_Module
   SG_ MIL_Lamp : 0|1@1+ (1,0) [0|0] "" Powertrain_Control_Module
   SG_ AC_Pressure : 0|1@1+ (1,0) [0|0] "" Powertrain_Control_Module
   SG_ ImmobLamp : 0|1@1+ (1,0) [0|0] "" Powertrain_Control_Module
   SG_ SEATBELT_INDICATOR_STAT : 0|1@1+ (1,0) [0|0] "" Powertrain_Control_Module
   SG_ ODO_COUNT : 0|1@1+ (1,0) [0|0] "" Powertrain_Control_Module

BO_ 1079 MSG6: 8 Powertrain_Control_Module
   SG_ InstFuelValue : 0|1@1+ (1,0) [0|0] "" Powertrain_Control_Module
   SG_ FuelSenderFail : 0|1@1+ (1,0) [0|0] "" Powertrain_Control_Module
   SG_ ParkBrakeOn_HS : 32|1@1+ (1,0) [0|0] "" Powertrain_Control_Module
   SG_ MaxLitres : 0|1@1+ (1,0) [0|0] "" Powertrain_Control_Module
   SG_ DampedFuelLevel : 0|1@1+ (1,0) [0|0] "" Powertrain_Control_Module

BO_ 1101 MSG7: 8 Powertrain_Control_Module
   SG_ EngineOilTemperature : 0|1@1+ (1,0) [0|0] "" Powertrain_Control_Module

BO_ 1107 MSG8: 8 Powertrain_Control_Module

BO_ 1200 MSG9: 8 Powertrain_Control_Module

BO_ 76 MSG10: 0 Powertrain_Control_Module

BO_ 1216 MSG1: 8 Powertrain_Control_Module

BO_ 1571 MSG2: 8 Powertrain_Control_Module

BO_ 1616 MSG1: 8 Powertrain_Control_Module

BO_ 1784 MSG2: 8 Powertrain_Control_Module

BO_ 2024 On_Board_Diagnostics: 8 Vector__XXX
   SG_ S1_PID_00_PIDsSupported_01_20 m0 : 31|32@0+ (1,0) [0|4.29497e+09] "" Vector__XXX
   SG_ S1_PID_01_MonitorStatus m1 : 31|32@0+ (1,0) [0|4.29497e+09] "" Vector__XXX
   SG_ S1_PID_02_FreezeDTC m2 : 31|16@0+ (1,0) [0|65535] "" Vector__XXX
   SG_ S1_PID_03_FuelSystemStatus m3 : 31|16@0+ (1,0) [0|65535] "" Vector__XXX
   SG_ S1_PID_04_CalcEngineLoad m4 : 31|8@0+ (0.39216,0) [0|100] "%" Vector__XXX
   SG_ S1_PID_05_EngineCoolantTemp m5 : 31|8@0+ (1,-40) [-40|215] "degC" Vector__XXX
   SG_ S1_PID_06_ShortFuelTrimBank1 m6 : 31|8@0+ (0.78125,-100) [-100|99.2188] "%" Vector__XXX
   SG_ S1_PID_07_LongFuelTrimBank1 m7 : 31|8@0+ (0.78125,-100) [-100|99.2188] "%" Vector__XXX
   SG_ S1_PID_08_ShortFuelTrimBank2 m8 : 31|8@0+ (0.78125,-100) [-100|99.2188] "%" Vector__XXX
   SG_ S1_PID_09_LongFuelTrimBank2 m9 : 31|8@0+ (0.78125,-100) [-100|99.2188] "%" Vector__XXX
   SG_ S1_PID_0A_FuelPressure m10 : 31|8@0+ (3,0) [0|765] "kPa" Vector__XXX
   SG_ S1_PID_0B_IntakeManiAbsPress m11 : 31|8@0+ (1,0) [0|255] "kPa" Vector__XXX
   SG_ S1_PID_0C_EngineRPM m12 : 31|16@0+ (0.25,0) [0|16383.8] "rpm" Vector__XXX
   SG_ S1_PID_0D_VehicleSpeed m13 : 31|8@0+ (1,0) [0|255] "km/h" Vector__XXX
   SG_ S1_PID_0E_TimingAdvance m14 : 31|8@0+ (0.5,-64) [-64|63.5] "deg before TDC" Vector__XXX
   SG_ S1_PID_0F_IntakeAirTemperature m15 : 31|8@0+ (1,-40) [-40|215] "degC" Vector__XXX
   SG_ S1_PID_10_MAFAirFlowRate m16 : 31|16@0+ (0.01,0) [0|655.35] "grams/sec" Vector__XXX
   SG_ S1_PID_11_ThrottlePosition m17 : 31|8@0+ (0.39216,0) [0|100] "%" Vector__XXX
   SG_ S1_PID_12_CmdSecAirStatus m18 : 31|8@0+ (1,0) [0|255] "" Vector__XXX
   SG_ S1_PID_14_OxySensor1_Volt m20 : 31|8@0+ (0.005,0) [0|1.275] "volts" Vector__XXX
   SG_ S1_PID_14_OxySensor1_STFT m20 : 39|8@0+ (0.78125,-100) [-100|99.2188] "%" Vector__XXX
   SG_ S1_PID_15_OxySensor2_Volt m21 : 31|8@0+ (0.005,0) [0|1.275] "volts" Vector__XXX
   SG_ S1_PID_15_OxySensor2_STFT m21 : 39|8@0+ (0.78125,-100) [-100|99.2188] "%" Vector__XXX
   SG_ S1_PID_16_OxySensor3_Volt m22 : 31|8@0+ (0.005,0) [0|1.275] "volts" Vector__XXX
   SG_ S1_PID_16_OxySensor3_STFT m22 : 39|8@0+ (0.78125,-100) [-100|99.2188] "%" Vector__XXX
   SG_ S1_PID_17_OxySensor4_Volt m23 : 31|8@0+ (0.005,0) [0|1.275] "volts" Vector__XXX
   SG_ S1_PID_17_OxySensor4_STFT m23 : 39|8@0+ (0.78125,-100) [-100|99.2188] "%" Vector__XXX
   SG_ S1_PID_18_OxySensor5_Volt m24 : 31|8@0+ (0.005,0) [0|1.275] "volts" Vector__XXX
   SG_ S1_PID_18_OxySensor5_STFT m24 : 39|8@0+ (0.78125,-100) [-100|99.2188] "%" Vector__XXX
   SG_ S1_PID_19_OxySensor6_Volt m25 : 31|8@0+ (0.005,0) [0|1.275] "volts" Vector__XXX
   SG_ S1_PID_19_OxySensor6_STFT m25 : 39|8@0+ (0.78125,-100) [-100|99.2188] "%" Vector__XXX
   SG_ S1_PID_1A_OxySensor7_Volt m26 : 31|8@0+ (0.005,0) [0|1.275] "volts" Vector__XXX
   SG_ S1_PID_1A_OxySensor7_STFT m26 : 39|8@0+ (0.78125,-100) [-100|99.2188] "%" Vector__XXX
   SG_ S1_PID_1B_OxySensor8_Volt m27 : 31|8@0+ (0.005,0) [0|1.275] "volts" Vector__XXX
   SG_ S1_PID_1B_OxySensor8_STFT m27 : 39|8@0+ (0.78125,-100) [-100|99.2188] "%" Vector__XXX
   SG_ S1_PID_1C_OBDStandard m28 : 31|8@0+ (1,0) [0|255] "" Vector__XXX
   SG_ S1_PID_1F_TimeSinceEngStart m31 : 31|16@0+ (1,0) [0|65535] "seconds" Vector__XXX
   SG_ S1_PID_20_PIDsSupported_21_40 m32 : 31|32@0+ (1,0) [0|4.29497e+09] "" Vector__XXX
   SG_ S1_PID_21_DistanceMILOn m33 : 31|16@0+ (1,0) [0|65535] "km" Vector__XXX
   SG_ S1_PID_22_FuelRailPres m34 : 31|16@0+ (0.079,0) [0|5177.27] "kPa" Vector__XXX
   SG_ S1_PID_23_FuelRailGaug m35 : 31|16@0+ (10,0) [0|655350] "kPa" Vector__XXX
   SG_ S1_PID_24_OxySensor1_FAER m36 : 31|16@0+ (3.05176e-05,0) [0|2] "ratio" Vector__XXX
   SG_ S1_PID_24_OxySensor1_Volt m36 : 47|16@0+ (0.00012207,0) [0|2] "volts" Vector__XXX
   SG_ S1_PID_25_OxySensor2_FAER m37 : 31|16@0+ (3.05176e-05,0) [0|2] "ratio" Vector__XXX
   SG_ S1_PID_25_OxySensor2_Volt m37 : 47|16@0+ (0.00012207,0) [0|8] "volts" Vector__XXX
   SG_ S1_PID_26_OxySensor3_FAER m38 : 31|16@0+ (3.05176e-05,0) [0|2] "ratio" Vector__XXX
   SG_ S1_PID_26_OxySensor3_Volt m38 : 47|16@0+ (0.00012207,0) [0|8] "volts" Vector__XXX
   SG_ S1_PID_27_OxySensor4_FAER m39 : 31|16@0+ (3.05176e-05,0) [0|2] "ratio" Vector__XXX
   SG_ S1_PID_27_OxySensor4_Volt m39 : 47|16@0+ (0.00012207,0) [0|8] "volts" Vector__XXX
   SG_ S1_PID_28_OxySensor5_FAER m40 : 31|16@0+ (3.05176e-05,0) [0|2] "ratio" Vector__XXX
   SG_ S1_PID_28_OxySensor5_Volt m40 : 47|16@0+ (0.00012207,0) [0|8] "volts" Vector__XXX
   SG_ S1_PID_29_OxySensor6_FAER m41 : 31|16@0+ (3.05176e-05,0) [0|2] "ratio" Vector__XXX
   SG_ S1_PID_29_OxySensor6_Volt m41 : 47|16@0+ (0.00012207,0) [0|8] "volts" Vector__XXX
   SG_ S1_PID_2A_OxySensor7_FAER m42 : 31|16@0+ (3.05176e-05,0) [0|2] "ratio" Vector__XXX
   SG_ S1_PID_2A_OxySensor7_Volt m42 : 47|16@0+ (0.00012207,0) [0|8] "volts" Vector__XXX
   SG_ S1_PID_2B_OxySensor8_FAER m43 : 31|16@0+ (3.05176e-05,0) [0|2] "ratio" Vector__XXX
   SG_ S1_PID_2B_OxySensor8_Volt m43 : 47|16@0+ (0.00012207,0) [0|8] "volts" Vector__XXX
   SG_ S1_PID_2C_CmdEGR m44 : 31|8@0+ (0.392157,0) [0|100] "%" Vector__XXX
   SG_ S1_PID_2D_EGRError m45 : 31|8@0+ (0.78125,-100) [-100|99.2188] "%" Vector__XXX
   SG_ S1_PID_2E_CmdEvapPurge m46 : 31|8@0+ (0.392157,0) [0|100] "%" Vector__XXX
   SG_ S1_PID_2F_FuelTankLevel m47 : 31|8@0+ (0.392157,0) [0|100] "%" Vector__XXX
   SG_ S1_PID_30_WarmUpsSinceCodeClear m48 : 31|8@0+ (1,0) [0|255] "count" Vector__XXX
   SG_ S1_PID_31_DistanceSinceCodeClear m49 : 31|16@0+ (1,0) [0|65535] "km" Vector__XXX
   SG_ S1_PID_32_EvapSysVaporPres m50 : 31|16@0- (0.25,0) [-8192|8191.75] "Pa" Vector__XXX
   SG_ S1_PID_33_AbsBaroPres m51 : 31|8@0+ (1,0) [0|255] "kPa" Vector__XXX
   SG_ S1_PID_34_OxySensor1_FAER m52 : 31|16@0+ (3.05176e-05,0) [0|2] "ratio" Vector__XXX
   SG_ S1_PID_34_OxySensor1_Crnt m52 : 47|16@0+ (0.00390625,-128) [-128|128] "mA" Vector__XXX
   SG_ S1_PID_35_OxySensor2_FAER m53 : 31|16@0+ (3.05176e-05,0) [0|2] "ratio" Vector__XXX
   SG_ S1_PID_35_OxySensor2_Crnt m53 : 47|16@0+ (0.00390625,-128) [-128|128] "mA" Vector__XXX
   SG_ S1_PID_36_OxySensor3_FAER m54 : 31|16@0+ (3.05176e-05,0) [0|2] "ratio" Vector__XXX
   SG_ S1_PID_36_OxySensor3_Crnt m54 : 47|16@0+ (0.00390625,-128) [-128|128] "mA" Vector__XXX
   SG_ S1_PID_37_OxySensor4_FAER m55 : 31|16@0+ (3.05176e-05,0) [0|2] "ratio" Vector__XXX
   SG_ S1_PID_37_OxySensor4_Crnt m55 : 47|16@0+ (0.00390625,-128) [-128|128] "mA" Vector__XXX
   SG_ S1_PID_38_OxySensor5_FAER m56 : 31|16@0+ (3.05176e-05,0) [0|2] "ratio" Vector__XXX
   SG_ S1_PID_38_OxySensor5_Crnt m56 : 47|16@0+ (0.00390625,-128) [-128|128] "mA" Vector__XXX
   SG_ S1_PID_39_OxySensor6_FAER m57 : 31|16@0+ (3.05176e-05,0) [0|2] "ratio" Vector__XXX
   SG_ S1_PID_39_OxySensor6_Crnt m57 : 47|16@0+ (0.00390625,-128) [-128|128] "mA" Vector__XXX
   SG_ S1_PID_3A_OxySensor7_FAER m58 : 31|16@0+ (3.05176e-05,0) [0|2] "ratio" Vector__XXX
   SG_ S1_PID_3A_OxySensor7_Crnt m58 : 47|16@0+ (0.00390625,-128) [-128|128] "mA" Vector__XXX
   SG_ S1_PID_3B_OxySensor8_FAER m59 : 31|16@0+ (3.05176e-05,0) [0|2] "ratio" Vector__XXX
   SG_ S1_PID_3B_OxySensor8_Crnt m59 : 47|16@0+ (0.00390625,-128) [-128|128] "mA" Vector__XXX
   SG_ S1_PID_3C_CatTempBank1Sens1 m60 : 31|16@0+ (0.1,-40) [-40|6513.5] "degC" Vector__XXX
   SG_ S1_PID_3D_CatTempBank2Sens1 m61 : 31|16@0+ (0.1,-40) [-40|6513.5] "degC" Vector__XXX
   SG_ S1_PID_3E_CatTempBank1Sens2 m62 : 31|16@0+ (0.1,-40) [-40|6513.5] "degC" Vector__XXX
   SG_ S1_PID_3F_CatTempBank2Sens2 m63 : 31|16@0+ (0.1,-40) [-40|6513.5] "degC" Vector__XXX
   SG_ S1_PID_40_PIDsSupported_41_60 m64 : 31|32@0+ (1,0) [0|4.29497e+09] "" Vector__XXX
   SG_ S1_PID_41_MonStatusDriveCycle m65 : 31|32@0+ (1,0) [0|4.29497e+09] "" Vector__XXX
   SG_ S1_PID_42_ControlModuleVolt m66 : 31|16@0+ (0.001,0) [0|65.535] "V" Vector__XXX
   SG_ S1_PID_43_AbsLoadValue m67 : 31|16@0+ (0.392157,0) [0|25700] "%" Vector__XXX
   SG_ S1_PID_44_FuelAirCmdEquiv m68 : 31|16@0+ (3.05176e-05,0) [0|2] "ratio" Vector__XXX
   SG_ S1_PID_45_RelThrottlePos m69 : 31|8@0+ (0.392157,0) [0|100] "%" Vector__XXX
   SG_ S1_PID_46_AmbientAirTemp m70 : 31|8@0+ (1,-40) [-40|215] "degC" Vector__XXX
   SG_ S1_PID_47_AbsThrottlePosB m71 : 31|8@0+ (0.392157,0) [0|100] "%" Vector__XXX
   SG_ S1_PID_48_AbsThrottlePosC m72 : 31|8@0+ (0.392157,0) [0|100] "%" Vector__XXX
   SG_ S1_PID_49_AbsThrottlePosD m73 : 31|8@0+ (0.392157,0) [0|100] "%" Vector__XXX
   SG_ S1_PID_4A_AbsThrottlePosE m74 : 31|8@0+ (0.392157,0) [0|100] "%" Vector__XXX
   SG_ S1_PID_4B_AbsThrottlePosF m75 : 31|8@0+ (0.392157,0) [0|100] "%" Vector__XXX
   SG_ S1_PID_4C_CmdThrottleAct m76 : 31|8@0+ (0.392157,0) [0|100] "%" Vector__XXX
   SG_ S1_PID_4D_TimeRunMILOn m77 : 31|16@0+ (1,0) [0|65535] "minutes" Vector__XXX
   SG_ S1_PID_4E_TimeSinceCodeClear m78 : 31|16@0+ (1,0) [0|65535] "minutes" Vector__XXX
   SG_ S1_PID_4F_Max_FAER m79 : 31|8@0+ (1,0) [0|255] "ratio" Vector__XXX
   SG_ S1_PID_4F_Max_OxySensVol m79 : 39|8@0+ (1,0) [0|255] "V" Vector__XXX
   SG_ S1_PID_4F_Max_OxySensCrnt m79 : 47|8@0+ (1,0) [0|255] "mA" Vector__XXX
   SG_ S1_PID_4F_Max_IntManiAbsPres m79 : 55|8@0+ (10,0) [0|2550] "kPa" Vector__XXX
   SG_ S1_PID_50_Max_AirFlowMAF m80 : 31|8@0+ (10,0) [0|2550] "g/s" Vector__XXX
   SG_ S1_PID_51_FuelType m81 : 31|8@0+ (1,0) [0|255] "" Vector__XXX
   SG_ S1_PID_52_EthanolFuelPct m82 : 31|8@0+ (0.392157,0) [0|100] "%" Vector__XXX
   SG_ S1_PID_53_AbsEvapSysVapPres m83 : 31|16@0+ (0.005,0) [0|327.675] "kPa" Vector__XXX
   SG_ S1_PID_54_EvapSysVapPres m84 : 31|16@0+ (1,-32767) [-32767|32768] "Pa" Vector__XXX
   SG_ S1_PID_55_ShortSecOxyTrimBank1 m85 : 31|8@0+ (0.78125,-100) [-100|99.2188] "%" Vector__XXX
   SG_ S1_PID_55_ShortSecOxyTrimBank3 m85 : 39|8@0+ (0.78125,-100) [-100|99.2188] "%" Vector__XXX
   SG_ S1_PID_56_LongSecOxyTrimBank1 m86 : 31|8@0+ (0.78125,-100) [-100|99.2188] "%" Vector__XXX
   SG_ S1_PID_56_LongSecOxyTrimBank3 m86 : 39|8@0+ (0.78125,-100) [-100|99.2188] "%" Vector__XXX
   SG_ S1_PID_57_ShortSecOxyTrimBank2 m87 : 31|8@0+ (0.78125,-100) [-100|99.2188] "%" Vector__XXX
   SG_ S1_PID_57_ShortSecOxyTrimBank4 m87 : 39|8@0+ (0.78125,-100) [-100|99.2188] "%" Vector__XXX
   SG_ S1_PID_58_LongSecOxyTrimBank2 m88 : 31|8@0+ (0.78125,-100) [-100|99.2188] "%" Vector__XXX
   SG_ S1_PID_58_LongSecOxyTrimBank4 m88 : 39|8@0+ (0.78125,-100) [-100|99.2188] "%" Vector__XXX
   SG_ S1_PID_59_FuelRailAbsPres m89 : 31|16@0+ (10,0) [0|655350] "kPa" Vector__XXX
   SG_ S1_PID_5A_RelAccelPedalPos m90 : 31|8@0+ (0.392157,0) [0|100] "%" Vector__XXX
   SG_ S1_PID_5B_HybrBatPackRemLife m91 : 31|8@0+ (0.392157,0) [0|100] "%" Vector__XXX
   SG_ S1_PID_5C_EngineOilTemp m92 : 31|8@0+ (1,-40) [-40|215] "degC" Vector__XXX
   SG_ S1_PID_5D_FuelInjectionTiming m93 : 31|16@0+ (0.0078125,-210) [-210|301.992] "deg" Vector__XXX
   SG_ S1_PID_5E_EngineFuelRate m94 : 31|16@0+ (0.05,0) [0|3276.75] "L/h" Vector__XXX
   SG_ S1_PID_5F_EmissionReq m95 : 31|8@0+ (1,0) [0|255] "" Vector__XXX
   SG_ S1_PID_60_PIDsSupported_61_80 m96 : 31|32@0+ (1,0) [0|4.29497e+09] "" Vector__XXX
   SG_ S1_PID_61_DemandEngTorqPct m97 : 31|8@0+ (1,-125) [-125|130] "%" Vector__XXX
   SG_ S1_PID_62_ActualEngTorqPct m98 : 31|8@0+ (1,-125) [-125|130] "%" Vector__XXX
   SG_ S1_PID_63_EngRefTorq m99 : 31|16@0+ (1,0) [0|65535] "Nm" Vector__XXX
   SG_ S1_PID_64_EngPctTorq_Idle m100 : 31|8@0+ (1,-125) [-125|130] "%" Vector__XXX
   SG_ S1_PID_64_EngPctTorq_EP1 m100 : 39|8@0+ (1,-125) [-125|130] "%" Vector__XXX
   SG_ S1_PID_64_EngPctTorq_EP2 m100 : 47|8@0+ (1,-125) [-125|130] "%" Vector__XXX
   SG_ S1_PID_64_EngPctTorq_EP3 m100 : 55|8@0+ (1,-125) [-125|130] "%" Vector__XXX
   SG_ S1_PID_64_EngPctTorq_EP4 m100 : 63|8@0+ (1,-125) [-125|130] "%" Vector__XXX
   SG_ S1_PID_65_AuxInputOutput m101 : 31|8@0+ (1,0) [0|255] "" Vector__XXX
   SG_ S1_PID_66_MAFSensor m102 : 31|8@0+ (1,0) [0|255] "" Vector__XXX
   SG_ S1_PID_67_EngineCoolantTemp m103 : 31|8@0+ (1,0) [0|255] "" Vector__XXX
   SG_ S1_PID_68_IntakeAirTempSens m104 : 31|8@0+ (1,0) [0|255] "" Vector__XXX
   SG_ S1_PID_69_CmdEGR_EGRError m105 : 31|8@0+ (1,0) [0|255] "" Vector__XXX
   SG_ S1_PID_6A_CmdDieselIntAir m106 : 31|8@0+ (1,0) [0|255] "" Vector__XXX
   SG_ S1_PID_6B_ExhaustGasTemp m107 : 31|8@0+ (1,0) [0|255] "" Vector__XXX
   SG_ S1_PID_6C_CmdThrottleActRel m108 : 31|8@0+ (1,0) [0|255] "" Vector__XXX
   SG_ S1_PID_6D_FuelPresContrSys m109 : 31|8@0+ (1,0) [0|255] "" Vector__XXX
   SG_ S1_PID_6E_InjPresContrSys m110 : 31|8@0+ (1,0) [0|255] "" Vector__XXX
   SG_ S1_PID_6F_TurboComprPres m111 : 31|8@0+ (1,0) [0|255] "" Vector__XXX
   SG_ S1_PID_70_BoostPresCntrl m112 : 31|8@0+ (1,0) [0|255] "" Vector__XXX
   SG_ S1_PID_80_PIDsSupported_81_A0 m128 : 31|32@0+ (1,0) [0|4.29497e+09] "" Vector__XXX
   SG_ S1_PID_8E_EngFrictionPctTorq m142 : 31|8@0+ (1,-125) [-125|130] "%" Vector__XXX
   SG_ S1_PID_A0_PIDsSupported_A1_C0 m160 : 31|32@0+ (1,0) [0|4.29497e+09] "" Vector__XXX
   SG_ S1_PID_C0_PIDsSupported_C1_E0 m192 : 31|32@0+ (1,0) [0|4.29497e+09] "" Vector__XXX
   SG_ S2_PID_02_FreezeDTC m2 : 31|16@0+ (1,0) [0|65535] "" Vector__XXX
   SG_ service M : 11|4@0+ (1,0) [0|15] "" Vector__XXX
   SG_ response : 15|4@0+ (1,0) [0|15] "" Vector__XXX
   SG_ length : 7|8@0+ (1,0) [0|255] "" Vector__XXX

BO_ 742 RDS_PSN_State: 8 Audio_Control_Module
   SG_ AudioTunedFreqency : 0|1@1+ (1,0) [0|0] "" Front_Display_Interface_Module
   SG_ AudioFMFrequencyStep : 0|1@1+ (1,0) [0|0] "" Front_Display_Interface_Module
   SG_ AudioTunerBandPreset : 0|1@1+ (1,0) [0|0] "" Front_Display_Interface_Module
   SG_ RDS_PSN_State : 0|1@1+ (1,0) [0|0] "" Front_Display_Interface_Module

BO_ 758 RDS___MESSAGE: 8 Audio_Control_Module

BA_DEF_ BO_ "GenMsgBackgroundColor" STRING ;
BA_DEF_ BO_ "GenMsgForegroundColor" STRING ;
BA_ "GenMsgBackgroundColor" BO_ 754 "#ff01dd";
BA_ "GenMsgForegroundColor" BO_ 296 "#00ffff";
BA_ "GenMsgBackgroundColor" BO_ 296 "#000000";
BA_ "GenMsgBackgroundColor" BO_ 761 "#ff1433";
BA_ "GenMsgBackgroundColor" BO_ 775 "#aa007f";
BA_ "GenMsgBackgroundColor" BO_ 742 "#ff7403";
BA_DEF_DEF_ "GenMsgBackgroundColor" "#ffffff";
BA_DEF_DEF_ "GenMsgForegroundColor" "#000000";
CM_ BO_ 754 "AudioCurrentMediaMode";
CM_ SG_ 754 AudioVolumeLevel "Volume";
CM_ BO_ 851 "HVAC DATA";
CM_ SG_ 851 FanSpeed "FanSpeed";
CM_ SG_ 296 FogLampStatus "Fog_Lamp_Status";
CM_ SG_ 296 HeadLightsOn "HeadLightsOn";
CM_ BO_ 787 "Cabin Temperature Sensor";
CM_ SG_ 787 INTACTTEMP "Interior_Temperature_Sensor_-_Integral_to_ICC._INTACTTEMP_=_Message.Data[0]_=_Temperature_-_100_/_2_L";
CM_ BO_ 775 "ICC HVAC Buttons";
CM_ BO_ 777 "RadioStationNameData [ASCII Data ICC]";
CM_ BO_ 1782 "Passive Anti Theft System";
CM_ SG_ 1063 EngineCoolantTemperature "EngCoolantTempSense";
CM_ SG_ 1063 EngineOverheat "EngineOverheat";
CM_ SG_ 1063 EngineOilPressure "EngOilPres";
CM_ SG_ 1063 OilPressureWarning "OilPressWarn";
CM_ SG_ 1063 ETC_Warning "ThrottleWarnETC";
CM_ SG_ 1063 FuelPulse "FuelPulse";
CM_ SG_ 1063 MIL_Lamp "Malfunction_Ind_Lamp";
CM_ SG_ 1063 ImmobLamp "Immobilised_Lamp";
VAL_ 754 AudioVolumeLevel 0 "Mute" 1 "Vol_Lvl_2" 2 "Vol_Lvl_4" 3 "Vol_Lvl_6" 4 "Vol_Lvl_8" 5 "Vol_Lvl_10" 6 "Vol_Lvl_12" 7 "Vol_Lvl_14" 8 "Vol_Lvl_16" 9 "Vol_Lvl_18" 10 "Vol_Lvl_20" 11 "Vol_Lvl_22" 12 "Vol_Lvl_24" 13 "Vol_Lvl_26" 14 "Vol_Lvl_28" 15 "Vol_Lvl_30";
VAL_ 754 SWCPhoneBtn 97 "PhoneBtn" 101 "PhoneBtn" 104 "PhoneBtn";
VAL_ 754 SWCVolUpBtn 24 "VolDownBtn" 25 "VolDownBtn";
VAL_ 754 SWCVolDownBtn 17 "VolUpBtn" 18 "VolUpBtn" 20 "VolUpBtn";
VAL_ 754 SWCModeBtn 1 "0X2EF#XXXXXXXXXXXX0FXX+_0x2F2#XXXXXXXXXXXX0F01_=_ModeBtn" 15 "0X2EF#XXXXXXXXXXXX0FXX+_0x2F2#XXXXXXXXXXXX0F01_=_ModeBtn";
VAL_ 754 AudioCurrentMediaMode 65 "No Description" 69 "" 72 "";
VAL_ 754 SWCSeekBtn 8 "SeekBtn" 9 "SeekBtn" 12 "SeekBtn";
VAL_ 718 BPM_Pair 0 "No Description" 0 "No Description";
VAL_ 296 HighBeamStatus 14 "HighBeamsON";
VAL_ 296 FogLampStatus 6 "FogLampsOn";
VAL_ 296 HeadLightsOn 2 "HeadLightsON";
VAL_ 296 HeadLightsAutoOn 1 "HeadLightsAUTO";
VAL_ 296 IndicatorRight 0 "" 16 "IndicatingRight";
VAL_ 296 IndicatorLeft 0 "" 8 "IndicatingLeft";
VAL_ 761 MP3_Folder 0 "No Description";
VAL_ 761 MP3_Track 0 "No Description";
VAL_ 1063 EngineCoolantTemperature 0 "No Description";
VAL_ 1063 OilPressureWarning 0 "No Description";
VAL_ 1079 ParkBrakeOn_HS 1 "HandBrakeOFF" 17 "HandBrakeOn";
VAL_ 742 AudioTunedFreqency 0 "No Description";
VAL_ 742 AudioFMFrequencyStep 0 "No Description";
VAL_ 742 AudioTunerBandPreset 0 "No Description";
VAL_ 742 RDS_PSN_State 0 "No Description";
